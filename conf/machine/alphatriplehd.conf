## conf/machine/alphatriplehd.conf
```bitbake
#@TYPE: Machine
#@NAME: alphatriple
#@DESCRIPTION: Machine configuration for SAB Alpha Triple HD

SOC_FAMILY = "bcm7241"

IMAGEDIR = "sab_alpha_triple"

require conf/machine/include/broadmedia-oem.inc

MACHINE_FEATURES += "dvb-c ci blindscan-dvbc"

MACHINE_ESSENTIAL_EXTRA_RDEPENDS += "\
    broadmedia-dvb-modules-alphatriplehd \
    "

DVBMEDIASINK_CONFIG = "--with-wma --with-wmv --with-pcm --with-dts --with-eac3"
```

## conf/machine/mbtwinplus.conf
```bitbake
#@TYPE: Machine
#@NAME: mbtwinplus
#@DESCRIPTION: Machine configuration for Miraclebox Premium Twin Plus

SOC_FAMILY = "bcm7241"

IMAGEDIR = "miraclebox/twinplus"

require conf/machine/include/broadmedia-oem.inc

MACHINE_FEATURES += "dvb-c ci blindscan-dvbc"

MACHINE_ESSENTIAL_EXTRA_RDEPENDS += "\
    broadmedia-dvb-modules-twinplus \
    "

DVBMEDIASINK_CONFIG = "--with-wma --with-wmv --with-pcm --with-dts --with-eac3"
```

## conf/machine/sf128.conf
```bitbake
#@TYPE: Machine
#@NAME: sf128
#@DESCRIPTION: Machine configuration for Octagon SF128

SOC_FAMILY = "bcm73625"

IMAGEDIR = "sf128"

require conf/machine/include/broadmedia-oem.inc

MACHINE_FEATURES += "ci 7segment"

MACHINE_ESSENTIAL_EXTRA_RDEPENDS += "\
    broadmedia-dvb-modules-g100 \
    "

DVBMEDIASINK_CONFIG = "--with-wma --with-wmv --with-pcm --with-dts --with-eac3 --with-h265 --with-vb6 --with-vb8 --with-spark"
```

## conf/machine/sf138.conf
```bitbake
#@TYPE: Machine
#@NAME: sf138
#@DESCRIPTION: Machine configuration for Octagon SF138

SOC_FAMILY = "bcm73625"

require conf/machine/include/broadmedia-oem.inc

MACHINE_FEATURES += "ci 7segment blindscan-dvbc dvb-c"

MACHINE_ESSENTIAL_EXTRA_RDEPENDS += "\
    broadmedia-dvb-modules-g100 \
    "

DVBMEDIASINK_CONFIG = "--with-wma --with-wmv --with-pcm --with-dts --with-eac3 --with-h265 --with-vb6 --with-vb8 --with-spark"
```

## conf/machine/sf3038.conf
```bitbake
#@TYPE: Machine
#@NAME: sf3038
#@DESCRIPTION: Machine configuration for Octagon SF3038

SOC_FAMILY = "bcm7241"

require conf/machine/include/broadmedia-oem.inc

MACHINE_FEATURES += "dvb-c ci blindscan-dvbc"

MACHINE_ESSENTIAL_EXTRA_RDEPENDS += "\
    broadmedia-dvb-modules-sf3038 \
    "

DVBMEDIASINK_CONFIG = "--with-wma --with-wmv --with-pcm --with-dts --with-eac3"
```
